## config/west.yml
```yaml
manifest:
  remotes:
    - name: zmkfirmware
      url-base: https://github.com/zmkfirmware
    - name: petejohanson
      url-base: https://github.com/petejohanson
  projects:
    - name: zmk.git
      remote: petejohanson
      revision: shileds/kyria-rev3
      import: app/west.yml
  self:
    path: config
```
